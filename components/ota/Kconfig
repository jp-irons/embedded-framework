## components/ota/Kconfig
```kconfig
menu "Framework OTA"

    config FRAMEWORK_HAS_FACTORY_PARTITION
        bool "Include factory partition"
        default y
        help
            Set to y when the partition table includes a factory app partition
            (e.g. partitions/factory_ota0_ota1.csv).  Set to n when using the
            two-slot OTA layout (partitions/ota0_ota1.csv).

            When disabled:
              - The boot-failure escalation path in OtaManager will not attempt
                to erase otadata and reboot to factory (there is nothing to boot
                into; the device would loop on the failing image instead).
              - The factory-reset API endpoint returns 501 Not Implemented.
              - The Factory Reset button is hidden in the web UI.

endmenu
```
